## conf/machine/firefly.conf
```bitbake
# Copyright (C) 2014 Romain Perier
# Released under the MIT license (see COPYING.MIT for the terms)

#@TYPE: Machine
#@NAME: Firefly RK3288
#@DESCRIPTION: Machine configuration for the firefly RK3288, based on Rockchip RK33288 SoC
#http://www.t-firefly.com/en/

require conf/machine/include/tune-cortexa15.inc

PREFERRED_PROVIDER_virtual/kernel = "linux"
SERIAL_CONSOLES = "115200;ttyS2"
KERNEL_IMAGETYPE = "zImage"
KERNEL_DEVICETREE_NAME = "rk3288-evb-act8846"
```

## conf/machine/include/rockchip.inc
```bitbake
# Copyright (C) 2014 NEO-Technologies
# Released under the MIT license (see COPYING.MIT for the terms)

require conf/machine/include/tune-cortexa9.inc

PREFERRED_PROVIDER_virtual/xserver = "xserver-xorg"

XSERVER = "xserver-xorg \
           xf86-video-fbturbo \
           xf86-input-evdev \
           xf86-input-mouse \
           xf86-input-keyboard"

PREFERRED_PROVIDER_virtual/kernel = "linux-rockchip-3.0"

KERNEL_IMAGETYPE = "Image"
IMAGE_CLASSES += "rockchip-update-img"
IMAGE_FSTYPES += "ext4 rockchip-update-img"

SERIAL_CONSOLES = "115200;ttyFIQ0"
```

## conf/machine/mars-board.conf
```bitbake
# Copyright (C) 2014 Romain Perier
# Released under the MIT license (see COPYING.MIT for the terms)

#@TYPE: Machine
#@NAME: MarsBoard RK3066 Board
#@DESCRIPTION: Machine configuration for the MarsBoard, based on Rockchip RK3066 SoC
#http://www.marsboard.com

require conf/machine/include/rockchip.inc

PREFERRED_PROVIDER_virtual/kernel = "linux"
SERIAL_CONSOLES = "115200;ttyS2"
KERNEL_DEVICETREE_NAME = "rk3066a-bqcurie2"
```

## conf/machine/radxa-rock.conf
```bitbake
# Copyright (C) 2014 NEO-Technologies
# Released under the MIT license (see COPYING.MIT for the terms)

#@TYPE: Machine
#@NAME: Radxa Rock Board
#@DESCRIPTION: Machine configuration for the Radxa Rock Board, based on Rockchip RK3188 CPU
#http://radxa.com

require conf/machine/include/rockchip.inc

PREFERRED_PROVIDER_virtual/kernel = "linux"
SERIAL_CONSOLES = "115200;ttyS2"
KERNEL_DEVICETREE_NAME = "rk3188-radxarock"
```

## conf/machine/rk3188.conf
```bitbake
# Copyright (C) 2014 NEO-Technologies
# Released under the MIT license (see COPYING.MIT for the terms)

#@TYPE: Machine
#@NAME: Generic RK3188
#@DESCRIPTION: Machine configuration based on Rockchip RK3188 CPU

require conf/machine/include/rockchip.inc

PREFERRED_PROVIDER_virtual/kernel = "linux-rockchip-3.0-rk3188"
```
